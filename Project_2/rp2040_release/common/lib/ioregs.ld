PROVIDE(SIO			= 0xd0000000);
PROVIDE(CLOCKS		= 0x40008000);
PROVIDE(IO_BANK0	= 0x40014000);
PROVIDE(RESETS		= 0x4000c000);
PROVIDE(PADS_BANK0	= 0x4001c000);
PROVIDE(XOSC		= 0x40024000);
PROVIDE(PLL_SYS		= 0x40028000);
PROVIDE(PLL_USB		= 0x4002c000);
PROVIDE(UART0		= 0x40034000);
PROVIDE(UART1       = 0x40038000);
PROVIDE(RTC		    = 0x4005c000);

PROVIDE(SPI0		= 0x4003c000);
PROVIDE(SPI01       = 0x40040000);

PROVIDE_HIDDEN(PPB	= 0xe0000000);
PROVIDE(ADC         = 0x4004C000);
PROVIDE(SYSTICK     = PPB + 0xe010);
PROVIDE(NVIC_ISER	= PPB + 0xe100);
PROVIDE(NVIC_ISPR   = PPB + 0xe200);

PROVIDE(DMA         = 0x50000000);
PROVIDE(PIO0    	= 0x50200000);
PROVIDE(PIO1        = 0x50300000);